## conf/layer.conf
```bitbake
#
# This file is protected by Copyright. Please refer to the COPYRIGHT file distributed 
# with this source distribution.
#
# This file is part of Geon Technology's meta-sca-jtnc.
#
# Geon Technology's meta-sca-jtnc is free software: you can redistribute it and/or 
# modify it under the terms of the GNU Lesser General Public License as published by 
# the Free Software Foundation, either version 3 of the License, or (at your option) 
# any later version.
#
# Geon Technology's meta-sca-jtnc is distributed in the hope that it will be useful, 
# but WITHOUT ANY WARRANTY; without even the implied warranty of MERCHANTABILITY or 
# FITNESS FOR A PARTICULAR PURPOSE.  See the GNU Lesser General Public License for more
# details.
#
# You should have received a copy of the GNU Lesser General Public License
# along with this program.  If not, see http://www.gnu.org/licenses/.
#

BBPATH .= ":${LAYERDIR}"
BBFILES += "\
    ${LAYERDIR}/recipes-*/*/*.bb \
    ${LAYERDIR}/recipes-*/*/*.bbappend \
    "
    
BBFILE_COLLECTIONS += "sca-jtnc"
BBFILE_PATTERN_sca-jtnc = "^${LAYERDIR}/"
BBFILE_PRIORITY_sca-jtnc = "10"
LAYERVERSION_sca-jtnc = "2"

LAYERDEPENDS_sca-jtnc = "\
    redhawk-sdr \
    "

# #####################################################
# Set this in your local.conf to override the version #
# (if available in this layer).                       #
# #####################################################
SCA_JTNC_VERSION ?= "4.1.0"
require conf/versions/sca-jtnc.inc
```
